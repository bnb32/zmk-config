## config/west.yml
```yaml
manifest:
  remotes:
    - name: zmkfirmware
      url-base: https://github.com/zmkfirmware
    - name: urob
      url-base: https://github.com/urob

  projects:
    - name: zmk
      remote: zmkfirmware
      revision: v0.2
      import: app/west.yml

    - name: zmk-helpers
      remote: urob
      revision: main
      path: modules/helpers

    - name: zmk-tri-state
      remote: urob
      revision: main
      path: modules/tri-state

  self:
    path: config
```
