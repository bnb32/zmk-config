/* 42 KEY MATRIX / LAYOUT MAPPING

  ╭─────────────────────────┬─────────────────────────╮
  │  1   2   3   4   5   6  │   7   8   9  10  11  12 │
  │ 13  14  15  16  17  18  │  19  20  21  22  23  24 │
  │ 25  26  27  28  29  30  │  31  32  33  34  35  36 │
  ╰───────────╮ 37  38  39  │  40  41  42 ╭───────────╯
              ╰─────────────┴─────────────╯

  ╭─────────────────────────┬─────────────────────────╮
  │ LT5 LT4 LT3 LT2 LT1 LT0 │ RT0 RT1 RT2 RT3 RT4 RT5 │
  │ LM5 LM4 LM3 LM2 LM1 LM0 │ RM0 RM1 RM2 RM3 RM4 RM5 │
  │ LB5 LB4 LB3 LB2 LB1 LB0 │ RB0 RB1 RB2 RB3 RB4 RB5 │
  ╰───────────╮ LH2 LH1 LH0 │ RH0 RH1 RH2 ╭───────────╯
              ╰─────────────┴─────────────╯

  ╭─────────────────────────┬─────────────────────────╮
  │ ESC  Q   W   E   R   T  │  Y   U   I   O   P   -  │
  │ TAB  A   S   D   F   G  │  H   J   K   L   ;   '  │
  │ SFT  Z   X   C   V   B  │  N   M   ,   .   /   \  │
  ╰───────────╮ FN  TAB RET │ SPC NUM MSE ╭───────────╯
              ╰─────────────┴─────────────╯

*/

// #include <behaviors/num_word.dtsi> // requires auto-layer module

#define KEYS_L LT0 LT1 LT2 LT3 LT4 \
               LM0 LM1 LM2 LM3 LM4 \
               LB0 LB1 LB2 LB3 LB4 // left hand
#define KEYS_R RT0 RT1 RT2 RT3 RT4 \
               RM0 RM1 RM2 RM3 RM4 \
               RB0 RB1 RB2 RB3 RB4 // right hand
#define THUMBS LH2 LH1 LH0 RH0 RH1 RH2 // thumbs
#define MOUSE_KEYS RT0 RT1 RT2 RT3 RT4 \
                   RM0 RM1 RM2 RM3 RM4 RM5 \
                   RB0 RB1 RB2 RB3 RB4 \
                   LM2 // don't deactivate mouse layer when control is held

#define QUICK_TAP_MS 150
#define HT_TAP_TERM 180
#define TD_TAP_TERM 190
#define HRM_TAP_TERM 180

// Set default mod tap tapping term
&mt {
  tapping-term-ms = <HT_TAP_TERM>;
};

// Set default layer tap tapping term
&lt {
  tapping-term-ms = <HT_TAP_TERM>; \
};

// General bindings --------------------------------------------------------------------------------------------------------------------

#define MAKE_TAP_DANCE(NAME, TAP, DANCE, TAPPING_TERM) \
  ZMK_TAP_DANCE(NAME, \
    tapping-term-ms = <TAPPING_TERM>; \
    bindings = <TAP>, <DANCE>; \
  )

#define MAKE_HOLD_TAP(NAME, HOLD, TAP, TAPPING_TERM, QUICK_TAP, IDLE_TIME) \
  ZMK_HOLD_TAP(NAME, \
    flavor = "balanced"; \
    tapping-term-ms = <TAPPING_TERM>; \
    quick-tap-ms = <QUICK_TAP>; \
    require-prior-idle-ms = <IDLE_TIME>; \
    bindings = <HOLD>, <TAP>; \
  )

// basic hold tap binding
MAKE_HOLD_TAP(ht, &kp, &kp, HT_TAP_TERM, QUICK_TAP_MS, 200)

// Make fast hold tap for "just hold" emulation
MAKE_HOLD_TAP(fht, &kp, &kp, 100, QUICK_TAP_MS, 100)

// custom backspace and delete macros
MAKE_TAP_DANCE(bspc, &kp BSPC, &ht LC(BSPC) BSPC, TD_TAP_TERM)
MAKE_TAP_DANCE(del, &kp DEL, &ht LC(DEL) DEL, TD_TAP_TERM)

// hold tap dance for shift / tab / caps_word
MAKE_TAP_DANCE(shft_tab_caps, &ht LSHFT TAB, &caps_word, 170)

// tap dance for apostrophe + return
MAKE_TAP_DANCE(apos_ret, &kp APOS, &kp RET, 120)

// tap dance for minus + bspc
MAKE_TAP_DANCE(minus_bspc, &kp MINUS, &kp BSPC, 150)

// tap dance for equal + bspc
MAKE_TAP_DANCE(equal_bspc, &kp EQUAL, &kp BSPC, 150)

// tap dance for plus + bspc
MAKE_TAP_DANCE(plus_bspc, &kp PLUS, &kp BSPC, 150)

// reuse basic mod-morph scheme
#define SIMPLE_MORPH(NAME, MOD, BINDING1, BINDING2) \
    ZMK_MOD_MORPH(NAME, \
        mods = <(MOD_L ## MOD|MOD_R ## MOD)>; \
        bindings = <BINDING1>, <BINDING2>; \
    )

// layer tap used to activate layer on hold and space_morph on tap
MAKE_HOLD_TAP(lt_spc, &mo, &spc_morph, HT_TAP_TERM, QUICK_TAP_MS, 0)

// tap: sticky-shift | shift + tap/ double-tap: caps-word | hold: shift
ZMK_MOD_MORPH(smart_shft,
    bindings = <&sk LSHFT>, <&caps_word>;
    mods = <(MOD_LSFT)>;
)

SIMPLE_MORPH(spc_morph, SFT, &kp SPACE, &dot_spc)

// no mod outputs lpar / rpar, ctrl outputs lbkt / rbkt, and ctrl + shft outputs lbrc / rbrc
ZMK_MOD_MORPH(lpar,
    bindings = <&kp LPAR>, <&kp LBKT>;
    mods = <(MOD_LCTL|MOD_RCTL)>;
)

ZMK_MOD_MORPH(rpar,
    bindings = <&kp RPAR>, <&kp RBKT>;
    mods = <(MOD_LCTL|MOD_RCTL)>;
)

// no mod outputs the number, shift outputs lpar / rpar, ctrl outputs lbkt / rbkt, and ctrl + shft outputs lbrc / rbrc
ZMK_MOD_MORPH(nine,
    bindings = <&kp N9>, <&lpar>;
    mods = <(MOD_LSFT|MOD_RSFT|MOD_LCTL|MOD_RCTL)>;
    keep-mods = <(MOD_LCTL|MOD_RCTL)>;
)

ZMK_MOD_MORPH(zero,
    bindings = <&kp N0>, <&rpar>;
    mods = <(MOD_LSFT|MOD_RSFT|MOD_LCTL|MOD_RCTL)>;
    keep-mods = <(MOD_LCTL|MOD_RCTL)>;
)


// Layer bindings ----------------------------------------------------------------------------------------------------------------------

// smart mouse keeps mouse layer activated unless non mouse button is pressed
ZMK_TRI_STATE(smart_mouse,
    bindings = <&tog MOUSE>, <&none>, <&tog MOUSE>;
    ignored-key-positions = <MOUSE_KEYS>;
    ignored-layers = <MOUSE>;
)

// tap: num-word | double-tap: sticky num-layer | hold: num-layer
// #define SMART_NUM &smart_num NUM 0

// smart number activates number layer on hold and num_dance on tap
// MAKE_HOLD_TAP(smart_num, &mo, &num_dance, HT_TAP_TERM, QUICK_TAP_MS, 0)

// toggle num layer on tap and num_word on double tap
// MAKE_TAP_DANCE(num_dance, &num_word NUM, &tog NUM, 200)

// layer hold tap
MAKE_HOLD_TAP(lht, &mo, &tog, 220, QUICK_TAP_MS, 220)

// Navigation bindings -------------------------------------------------------------------------------------------------------------------------------------------------------------------------------------------------------------------------------

// hold tap for navigation - shorter tapping term and no prior idle time
MAKE_HOLD_TAP(nht, &kp, &kp, 175, 175, 0)

MAKE_TAP_DANCE(down, &kp DOWN, &nht LC(END) DOWN, 150)
MAKE_TAP_DANCE(up, &kp UP, &nht LC(HOME) UP, 150)
MAKE_TAP_DANCE(left, &kp LEFT, &nht HOME LEFT, 150)
MAKE_TAP_DANCE(right, &kp RIGHT, &nht END RIGHT, 150)


// HOMEROW MODS --------------------------------------------------------------------------------------------------------------------------------------------------------------------------------------------------------------------------------------

#define MAKE_HRM(NAME, HOLD, TAP, TRIGGER_POS, TAPPING_TERM, QUICK_TAP, IDLE_TIME) \
  ZMK_HOLD_TAP(NAME, \
    flavor = "balanced"; \
    tapping-term-ms = <TAPPING_TERM>; \
    quick-tap-ms = <QUICK_TAP>; \
    require-prior-idle-ms = <IDLE_TIME>; \
    bindings = <HOLD>, <TAP>; \
    hold-trigger-key-positions = <TRIGGER_POS>; \
    hold-trigger-on-release; \
  )

MAKE_HRM(hml, &kp, &kp, KEYS_R THUMBS, HRM_TAP_TERM, QUICK_TAP_MS, 200)
MAKE_HRM(hmr, &kp, &kp, KEYS_L THUMBS, HRM_TAP_TERM, QUICK_TAP_MS, 200)

// left-hand gui - tend to hold this longer during normal typing
MAKE_HRM(hmlg, &kp, &kp, KEYS_R THUMBS, 220, QUICK_TAP_MS, 200)

// left-hand shift - tend to hold this longer during normal typing
MAKE_HRM(hmls, &kp, &kp, KEYS_R THUMBS, 220, QUICK_TAP_MS, 200)

#define HRMR(k1,k2,k3,k4) &hmr RALT k1 &hmr RCTRL k2 &hmr RSHFT k3 &hmr RGUI k4
#define HRML(k1,k2,k3) &hml LSHFT k1 &hml LCTRL k2 &hml LALT k3

// Combos ----------------------------------------------------------------------------------------------------------------

// HRM combo hack - workaround for lack of tap-only combos (ZMK issue #544)
#define ZMK_COMBO_8(NAME, TAP, KEYPOS, LAYERS, COMBO_TERM, COMBO_IDLE, HOLD, SIDE) \
    MAKE_HRM(hm_combo_ ## NAME, &kp, TAP, SIDE THUMBS, HRM_TAP_TERM, QUICK_TAP_MS, 200) \
    ZMK_COMBO_6(NAME, &hm_combo_ ## NAME HOLD 0, KEYPOS, LAYERS, COMBO_TERM, COMBO_IDLE)


// Behaviors --------------------------------------------------------------------------------------------------------------------------------------------------------------------

#define AS(keycode) &as LS(keycode) keycode  // Autoshift Macro

/ {
    behaviors {
        as: auto_shift {
            compatible = "zmk,behavior-hold-tap";
            #binding-cells = <2>;
            tapping-term-ms = <135>;
            quick-tap-ms = <0>;
            flavor = "tap-preferred";
            bindings = <&kp>, <&kp>;
        };
    };
};

// MACROS --------------------------------------------------------------------------------------------------------------------------------------------------------------------------------------------------------------------------------------

/ {

  macros {

    win_right: win_right {
      compatible = "zmk,behavior-macro";
      #binding-cells = <0>;
      bindings = <&kp RG(RIGHT) &kp ESC>;
    };

    win_left: win_left {
      compatible = "zmk,behavior-macro";
      #binding-cells = <0>;
      bindings = <&kp RG(LEFT) &kp ESC>;
    };

    win_up: win_up {
      compatible = "zmk,behavior-macro";
      #binding-cells = <0>;
      bindings = <&kp RG(UP) &kp ESC>;
    };

    win_down: win_down {
      compatible = "zmk,behavior-macro";
      #binding-cells = <0>;
      bindings = <&kp RG(DOWN) &kp ESC>;
    };

    dot_spc: dot_spc {
      compatible = "zmk,behavior-macro";
      wait-ms = <0>;
      tap-ms = <5>;
      #binding-cells = <0>;
      bindings = <&kp DOT &kp SPACE &sk LSHFT>;
    };
  };
};

// Aliases -----------------------------------------------------------------------------------

#define FORMAT &kp RS(RA(F))
#define WIN_CLOSE &kp RC(F4)
#define APP_CLOSE &kp RA(F4)
#define NEXT_WIN &kp RC(TAB)
#define PREV_WIN &kp LS(RC(TAB))
#define NEXT_APP &kp LG(TAB)

#define SAVE &kp LC(S)

// C_ for "custom"
#define C_CUT &kp LC(X)
#define C_COPY &kp LC(INS)
#define C_PASTE &kp LS(INS)
#define C_BSPC &kp BSPC
#define C_DEL &kp DEL

#define NAV_U &up
#define NAV_D &down
#define NAV_R &right
#define NAV_L &left

#define CANCEL &kp K_CANCEL
#define MUTE &kp C_MUTE
#define VOL_U &kp C_VOL_UP
#define VOL_D &kp C_VOL_DN
#define PAUSE &kp C_PP
#define NEXT &kp C_NEXT
#define PREV &kp C_PREV

#define WIN_U &win_up
#define WIN_D &win_down
#define WIN_R &win_right
#define WIN_L &win_left

#define NAV_TOG &lht NAV NAV
#define MOUSE_TOG &lht MOUSE MOUSE
#define SYS_TOG &lht SYS SYS

#define HOME_MT &mt LC(HOME) HOME
#define END_MT &mt LC(END) END

#define APOS_RET &apos_ret
#define MINUS_BSPC &minus_bspc
#define EQUAL_BSPC &equal_bspc
#define PLUS_BSPC &plus_bspc

#define SMART_SHFT &smart_shft
#define SMART_MOUSE &smart_mouse