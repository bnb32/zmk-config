#include <dt-bindings/zmk/mouse.h>
#include <behaviors/mouse_keys.dtsi>

#undef ZMK_MOUSE_DEFAULT_MOVE_VAL
#undef U_MOUSE_MOVE_EXPONENT
#undef U_MOUSE_MOVE_TIME
#undef U_MOUSE_MOVE_DELAY

#undef ZMK_MOUSE_DEFAULT_SCRL_VAL
#undef U_MOUSE_SCROLL_EXPONENT
#undef U_MOUSE_SCROLL_TIME
#undef U_MOUSE_SCROLL_DELAY

#define ZMK_MOUSE_DEFAULT_MOVE_VAL 5000
#define U_MOUSE_MOVE_EXPONENT 1
#define U_MOUSE_MOVE_TIME 20
#define U_MOUSE_MOVE_DELAY 0

#define ZMK_MOUSE_DEFAULT_SCRL_VAL 1000
#define U_MOUSE_SCROLL_EXPONENT 1
#define U_MOUSE_SCROLL_TIME 20
#define U_MOUSE_SCROLL_DELAY 0


#define U_MS_U &mmv MOVE_UP
#define U_MS_D &mmv MOVE_DOWN
#define U_MS_L &mmv MOVE_LEFT
#define U_MS_R &mmv MOVE_RIGHT
#define U_WH_U &msc SCRL_UP
#define U_WH_D &msc SCRL_DOWN
#define U_WH_L &msc SCRL_LEFT
#define U_WH_R &msc SCRL_RIGHT
#define U_CL_L &mkp LCLK
#define U_CL_R &mkp RCLK
#define U_CL_F &mkp MB5
#define U_CL_B &mkp MB4
