/* 60 KEY MATRIX / LAYOUT MAPPING

  ╭────────────────────────────┬────────────────────────────╮
  │  0   1   2   3   4   5     │      6   7   8   9  10  11 │
  │ 12  13  14  15  16  17     │     18  19  20  21  22  23 │
  │ 24  25  26  27  28  29     │     30  31  32  33  34  35 │
  │ 36  37  38  39  40  41  42 │ 43  44  45  46  47  48  49 │
  ╰───────╮ 50  51  52  53  54 │ 55  56  57  58  59 ╭───────╯
          ╰────────────────────┴────────────────────╯
 ╭─────────────────────────────┬─────────────────────────────╮
 │ LN5 LN4 LN3 LN2 LN1 LN0     │     RN0 RN1 RN2 RN3 RN4 RN5 │
 │ LT5 LT4 LT3 LT2 LT1 LT0     │     RT0 RT1 RT2 RT3 RT4 RT5 │
 │ LM5 LM4 LM3 LM2 LM1 LM0     │     RM0 RM1 RM2 RM3 RM4 RM5 │
 │ LB5 LB4 LB3 LB2 LB1 LB0 LEC │ REC RB0 RB1 RB2 RB3 RB4 RB5 │
 ╰───────╮ LH4 LH3 LH2 LH1 LH0 │ RH0 RH1 RH2 RH3 RH4 ╭───────╯
         ╰─────────────────────┴─────────────────────╯
  ╭────────────────────────────┬────────────────────────────╮
  │  `   1   2   3   4   5     │      6   7   8   9   0   = │
  │ ESC  Q   W   E   R   T     │      Y   U   I   O   P   - │
  │ TAB  A   S   D   F   G     │      H   J   K   L   ;   ' │
  │ SFT  Z   X   C   V   B ROT │ ROT  N   M   ,   .   /   \ │
  ╰───────╮ 50  51  52  53  54 │ 55  56  57  58  59 ╭───────╯
          ╰────────────────────┴────────────────────╯
*/

#define X_TOP_DEF &kp GRAVE &kp N1 &kp N2 &kp N3 &kp N4 &kp N5 &kp N6 &kp N7 &kp N8 &kp N9 &kp N0 &kp EQUAL
#define X_TOP_NON_DEF ___ ___ ___ ___ ___ ___ ___ ___ ___ ___ ___ ___
#define X_RT_DEF &kp LBKT &kp RBKT &none
#define X_LT_DEF &none &none SMART_MOUSE
#define X_RT_NON_DEF ___ ___ ___
#define X_LT_NON_DEF ___ ___ ___
#define X_ENC &bootloader &bootloader

// number of keys per side, plus six?
&led_strip {
    chain-length = <35>;
};


#define ENCODERS &inc_dec_kp C_VOL_DN C_VOL_UP &inc_dec_kp PG_DN PG_UP
#define INCLUDE_ENCODERS
#define CONFIG_RGB
#define CONFIG_WIRELESS
#include "zmk-helpers/key-labels/sofle.h"
#include "../base.keymap"