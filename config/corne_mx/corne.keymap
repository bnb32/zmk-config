/* 42 KEY MATRIX / LAYOUT MAPPING

  ╭─────────────────────────┬─────────────────────────╮
  │  1   2   3   4   5   6  │   7   8   9  10  11  12 │
  │ 13  14  15  16  17  18  │  19  20  21  22  23  24 │
  │ 25  26  27  28  29  30  │  31  32  33  34  35  36 │
  ╰───────────╮ 37  38  39  │  40  41  42 ╭───────────╯
              ╰─────────────┴─────────────╯

  ╭─────────────────────────┬─────────────────────────╮
  │ LT5 LT4 LT3 LT2 LT1 LT0 │ RT0 RT1 RT2 RT3 RT4 RT5 │
  │ LM5 LM4 LM3 LM2 LM1 LM0 │ RM0 RM1 RM2 RM3 RM4 RM5 │
  │ LB5 LB4 LB3 LB2 LB1 LB0 │ RB0 RB1 RB2 RB3 RB4 RB5 │
  ╰───────────╮ LH2 LH1 LH0 │ RH0 RH1 RH2 ╭───────────╯
              ╰─────────────┴─────────────╯

  ╭─────────────────────────┬─────────────────────────╮
  │ ESC  Q   W   E   R   T  │  Y   U   I   O   P   -  │
  │ TAB  A   S   D   F   G  │  H   J   K   L   ;   '  │
  │ SFT  Z   X   C   V   B  │  N   M   ,   .   /   \  │
  ╰───────────╮ 37  38  39  │  40  41  42 ╭───────────╯
              ╰─────────────┴─────────────╯

*/

// number of keys per side, plus six?
&led_strip {
    chain-length = <27>;
};

#define CONFIG_RGB

#define X_RT_DEF &kp RGUI
#define X_LT_DEF SMART_MOUSE
#define X_RT_NON_DEF ___
#define X_LT_NON_DEF ___
#define CONFIG_WIRELESS
#define SMALL_BOARD
#include "zmk-helpers/key-labels/42.h"
#include "../base.keymap"