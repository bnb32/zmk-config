/* 42 KEY MATRIX / LAYOUT MAPPING

  ╭─────────────────────────┬─────────────────────────╮
  │  1   2   3   4   5   6  │   7   8   9  10  11  12 │
  │ 13  14  15  16  17  18  │  19  20  21  22  23  24 │
  │ 25  26  27  28  29  30  │  31  32  33  34  35  36 │
  ╰───────────╮ 37  38  39  │  40  41  42 ╭───────────╯
              ╰─────────────┴─────────────╯

  ╭─────────────────────────┬─────────────────────────╮
  │ LT5 LT4 LT3 LT2 LT1 LT0 │ RT0 RT1 RT2 RT3 RT4 RT5 │
  │ LM5 LM4 LM3 LM2 LM1 LM0 │ RM0 RM1 RM2 RM3 RM4 RM5 │
  │ LB5 LB4 LB3 LB2 LB1 LB0 │ RB0 RB1 RB2 RB3 RB4 RB5 │
  ╰───────────╮ LH2 LH1 LH0 │ RH0 RH1 RH2 ╭───────────╯
              ╰─────────────┴─────────────╯

  ╭─────────────────────────┬─────────────────────────╮
  │ ESC  Q   W   E   R   T  │  Y   U   I   O   P   -  │
  │ TAB  A   S   D   F   G  │  H   J   K   L   ;   '  │
  │ SFT  Z   X   C   V   B  │  N   M   ,   .   /   \  │
  ╰───────────╮ 37  38  39  │  40  41  42 ╭───────────╯
              ╰─────────────┴─────────────╯

*/

#include <behaviors.dtsi>
#include <dt-bindings/zmk/keys.h>
#include <dt-bindings/zmk/outputs.h>
#include "zmk-helpers/helper.h"

#ifdef CONFIG_WIRELESS
    #include <dt-bindings/zmk/bt.h>
    #define BT_SEL_KEYS &out OUT_TOG &bt BT_PRV &bt BT_NXT &none &out OUT_BLE &bt BT_CLR
#else
    #define BT_SEL_KEYS &none &none &none &none &none &none
#endif

#ifdef CONFIG_RGB
    #include <dt-bindings/zmk/rgb.h>
    #define RGB_BOTTOM &rgb_ug RGB_SAD &rgb_ug RGB_SAI &none &none &none &none
    #define RGB_HOME &rgb_ug RGB_EFF &rgb_ug RGB_HUD &rgb_ug RGB_HUI &rgb_ug RGB_BRD &rgb_ug RGB_BRI &rgb_ug RGB_TOG
#else
    #define RGB_HOME &none &none &none &none &none &none
    #define RGB_BOTTOM &none &none &none &none &none &none
#endif

#ifdef SMALL_BOARD
    #define FN_ROW ___ &kp F1 &kp F2 &kp F3 &kp F4 &kp F5 &kp F6 &kp F7 &kp F8 &kp F9 &kp F10 &kp F11
    #define THUMB_ROW_DEF X_LT_DEF LS_TAB SYS_SPC NAV_SPC NUM_TOG X_RT_DEF
#else
    #define FN_ROW ___ &kp F1 &kp F2 &kp F3 &kp F4 &kp F5 &kp F6 &kp F7 &kp F8 &kp F9 &kp F10 &kp F11 \
                   ___ ___ ___ ___ ___ ___ ___ ___ ___ ___ ___ &kp F12
    #define THUMB_ROW_DEF X_LT_DEF LS_TAB SYS_SPC NAV_SPC RS_TAB X_RT_DEF
#endif

#define THUMB_ROW_NON_DEF X_LT_NON_DEF &kp LSHFT ___ &kp SPACE ___ X_RT_NON_DEF

#define DEF 0
#define NAV 1
#define SYS 2
#define MOUSE 3
#define MEDIA 4
#define NUM 5

#include "mouse.dtsi"
#include "extra_keys.h"
#include <behaviors.dtsi>
#include <dt-bindings/zmk/outputs.h>
#include "custom.dtsi"
#include "combos.dtsi"


/* Keymap ----------------------------------------------------------------------------------------------------------- */

#define XXX &none
#define ___ &trans

#define LS_TAB &mt LSHFT TAB
#define NAV_SPC &lt_spc NAV 0
#define SYS_SPC &lt_spc SYS 0
#define RS_TAB &mt RSHFT TAB

ZMK_CONDITIONAL_LAYER(media, SYS NAV, MEDIA)  // SYS + NAV --> MEDIA

ZMK_LAYER(brandon,
                                                                                        X_TOP_DEF
//├─────────────┼─────────────┼─────────────┼─────────────┼─────────────┼─────────────┤ ├───────┤ ├─────────────┼─────────────┼─────────────┼─────────────┼─────────────┼─────────────┤
    &kp ESC       &kp Q         &kp W         &kp E         &kp R         &kp T                     &kp Y         &kp U         &kp I         &kp O         &kp P         &kp MINUS
//├─────────────┼─────────────┼─────────────┼─────────────┼─────────────┼─────────────┤ ├───────┤ ├─────────────┼─────────────┼─────────────┼─────────────┼─────────────┼─────────────┤
    CANCEL        HRML(A,       S,            D,            F)            &kp G                     &kp H         HRMR(J,       K,            L,            SEMI)         &kp APOS
//├─────────────┼─────────────┼─────────────┼─────────────┼─────────────┼─────────────┤ ├───────┤ ├─────────────┼─────────────┼─────────────┼─────────────┼─────────────┼─────────────┤
    &caps_word    &kp Z         &kp X         &kp C         &kp V         &kp B           X_ENC     &kp N         &kp M         &kp COMMA     &kp DOT       &kp FSLH      &kp BSLH
//├─────────────┼─────────────┼─────────────┼─────────────┼─────────────┼─────────────┤ ├───────┤ ├─────────────┼─────────────┼─────────────┼─────────────┼─────────────┼─────────────┤
                                                                                      THUMB_ROW_DEF
            #ifdef INCLUDE_ENCODERS
                , ENCODERS
            #endif
)

ZMK_LAYER(navigate,
                                                                                      X_TOP_NON_DEF
//├─────────────┼─────────────┼─────────────┼─────────────┼─────────────┼─────────────┤ ├───────┤ ├─────────────┼─────────────┼─────────────┼─────────────┼─────────────┼─────────────┤
    ___           ___           ___           ___           ___           ___                       U_WH_U        C_BSPC        NAV_U         C_DEL         U_CL_F        &kp PG_UP
//├─────────────┼─────────────┼─────────────┼─────────────┼─────────────┼─────────────┤ ├───────┤ ├─────────────┼─────────────┼─────────────┼─────────────┼─────────────┼─────────────┤
    ___           ___           ___           ___           ___           ___                       U_WH_D        NAV_L         NAV_D         NAV_R         U_CL_B        &kp PG_DN
//├─────────────┼─────────────┼─────────────┼─────────────┼─────────────┼─────────────┤ ├───────┤ ├─────────────┼─────────────┼─────────────┼─────────────┼─────────────┼─────────────┤
    ___           ___           ___           ___           ___           ___             X_ENC     NEXT_APP      &kp RET       PREV_WIN      NEXT_WIN      ___           ___
//├─────────────┼─────────────┼─────────────┼─────────────┼─────────────┼─────────────┤ ├───────┤ ├─────────────┼─────────────┼─────────────┼─────────────┼─────────────┼─────────────┤
                                                                                    THUMB_ROW_NON_DEF
)

ZMK_LAYER(system,
                                                                                          FN_ROW
//├─────────────┼─────────────┼─────────────┼─────────────┼─────────────┼─────────────┤ ├───────┤ ├─────────────┼─────────────┼─────────────┼─────────────┼─────────────┼─────────────┤
                                        BT_SEL_KEYS                                                                                      RGB_HOME
//├─────────────┼─────────────┼─────────────┼─────────────┼─────────────┼─────────────┤ ├───────┤ ├─────────────┼─────────────┼─────────────┼─────────────┼─────────────┼─────────────┤
    ___           ___           ___           ___           &kp RET       ___             X_ENC                                         RGB_BOTTOM
//├─────────────┼─────────────┼─────────────┼─────────────┼─────────────┼─────────────┤ ├───────┤ ├─────────────┼─────────────┼─────────────┼─────────────┼─────────────┼─────────────┤
                                                                                    THUMB_ROW_NON_DEF
)

ZMK_LAYER(mouse,
                                                                                      X_TOP_NON_DEF
//├─────────────┼─────────────┼─────────────┼─────────────┼─────────────┼─────────────┤ ├───────┤ ├─────────────┼─────────────┼─────────────┼─────────────┼─────────────┼─────────────┤
    ___           ___           ___           ___           ___           ___                       U_WH_U        U_CL_L        U_MS_U        U_CL_R        U_CL_F        ___
//├─────────────┼─────────────┼─────────────┼─────────────┼─────────────┼─────────────┤ ├───────┤ ├─────────────┼─────────────┼─────────────┼─────────────┼─────────────┼─────────────┤
    ___           ___           ___           ___           ___           ___                       U_WH_D        U_MS_L        U_MS_D        U_MS_R        U_CL_B        ___
//├─────────────┼─────────────┼─────────────┼─────────────┼─────────────┼─────────────┤ ├───────┤ ├─────────────┼─────────────┼─────────────┼─────────────┼─────────────┼─────────────┤
    ___           ___           ___           ___           ___           ___             X_ENC     ___           &kp RET       U_WH_L        U_WH_R        ___           ___
//├─────────────┼─────────────┼─────────────┼─────────────┼─────────────┼─────────────┤ ├───────┤ ├─────────────┼─────────────┼─────────────┼─────────────┼─────────────┼─────────────┤
                                                                                    THUMB_ROW_NON_DEF
)

ZMK_LAYER(media,
                                                                                      X_TOP_NON_DEF
//├─────────────┼─────────────┼─────────────┼─────────────┼─────────────┼─────────────┤ ├───────┤ ├─────────────┼─────────────┼─────────────┼─────────────┼─────────────┼─────────────┤
    ___           ___           ___           ___           ___           ___                       ___           MUTE          VOL_U         PAUSE         ___           ___
//├─────────────┼─────────────┼─────────────┼─────────────┼─────────────┼─────────────┤ ├───────┤ ├─────────────┼─────────────┼─────────────┼─────────────┼─────────────┼─────────────┤
    ___           ___           ___           ___           ___           ___                       ___           PREV          VOL_D         NEXT          ___           ___
//├─────────────┼─────────────┼─────────────┼─────────────┼─────────────┼─────────────┤ ├───────┤ ├─────────────┼─────────────┼─────────────┼─────────────┼─────────────┼─────────────┤
    ___           ___           ___           ___           ___           ___             X_ENC     ___           ___           ___           ___           ___           ___
//├─────────────┼─────────────┼─────────────┼─────────────┼─────────────┼─────────────┤ ├───────┤ ├─────────────┼─────────────┼─────────────┼─────────────┼─────────────┼─────────────┤
                                                                                    THUMB_ROW_NON_DEF
)

#ifdef SMALL_BOARD
    ZMK_LAYER(number,
                                                                                          X_TOP_NON_DEF
    //├─────────────┼─────────────┼─────────────┼─────────────┼─────────────┼─────────────┤ ├───────┤ ├─────────────┼─────────────┼─────────────┼─────────────┼─────────────┼─────────────┤
        &kp GRAVE     &kp N1        &kp N2        &kp N3        &kp N4        &kp N5                    &kp N6        &kp N7        &kp N8        &nine_morph   &zero_morph   &kp EQUAL
    //├─────────────┼─────────────┼─────────────┼─────────────┼─────────────┼─────────────┤ ├───────┤ ├─────────────┼─────────────┼─────────────┼─────────────┼─────────────┼─────────────┤
        ___           ___           &kp LSHFT     &kp LCTRL     &kp LALT      ___                       ___           ___           ___           &kp LBKT      &kp RBKT      ___
    //├─────────────┼─────────────┼─────────────┼─────────────┼─────────────┼─────────────┤ ├───────┤ ├─────────────┼─────────────┼─────────────┼─────────────┼─────────────┼─────────────┤
        ___           ___           ___           ___           ___           ___             X_ENC     ___           ___           ___           ___           ___           ___
    //├─────────────┼─────────────┼─────────────┼─────────────┼─────────────┼─────────────┤ ├───────┤ ├─────────────┼─────────────┼─────────────┼─────────────┼─────────────┼─────────────┤
                                                                                        THUMB_ROW_NON_DEF
    )
#endif